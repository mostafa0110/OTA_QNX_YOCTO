## target-yocto/meta-ota/conf/layer.conf
```bitbake
BBPATH .= ":${LAYERDIR}"
BBFILES += "${LAYERDIR}/recipes-*/*/*.bb ${LAYERDIR}/recipes-*/*/*.bbappend"

BBFILE_COLLECTIONS += "ota"
BBFILE_PATTERN_ota = "^${LAYERDIR}/"
BBFILE_PRIORITY_ota = "10"

LAYERDEPENDS_ota = "core raspberrypi"
LAYERSERIES_COMPAT_ota = "scarthgap"
```

## target-yocto/meta-ota/wic/ota-ab.wks
```
# STARTING POINT — A/B layout for tryboot-based RAUC on RPi5. Validate in Spike B.
# tryboot/autoboot.txt selects the boot partition; RAUC writes the inactive rootfs slot.

part /boot   --source bootimg-partition --fstype=vfat --label boot   --align 4096 --fixed-size 64M --active
part /        --source rootfs           --fstype=ext4 --label rootfsA --align 4096 --fixed-size 1536M
part         --fstype=ext4 --label rootfsB --align 4096 --fixed-size 1536M
part /data   --fstype=ext4 --label data   --align 4096 --fixed-size 512M
```
